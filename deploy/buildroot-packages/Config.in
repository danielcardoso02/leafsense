## deploy/buildroot-packages/Config.in
```kconfig
menu "LeafSense packages"
	source "$BR2_EXTERNAL_LEAFSENSE_PATH/package/leafsense-led/Config.in"
endmenu
```

## deploy/buildroot-packages/package/leafsense-led/Config.in
```kconfig
config BR2_PACKAGE_LEAFSENSE_LED
	bool "leafsense-led"
	depends on BR2_LINUX_KERNEL
	help
	  LeafSense LED Alert Driver - Linux kernel module for GPIO LED control.
	  
	  Provides /dev/led0 character device for controlling alert LED.
	  Write '1' to turn ON, '0' to turn OFF.
	  
	  Requires GPIO pin 20 connected to LED with current-limiting resistor.
	  
	  https://github.com/leafsense/leafsense-project
```
